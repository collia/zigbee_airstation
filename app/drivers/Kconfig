## app/drivers/Kconfig
```kconfig
# Copyright (c) 2021 Nordic Semiconductor ASA
# SPDX-License-Identifier: Apache-2.0

menu "Drivers"
rsource "blink/Kconfig"
rsource "lcd5110/Kconfig"
endmenu
```

## app/drivers/lcd5110/Kconfig
```kconfig
# Configuration options for dummy display

# Copyright (c) 2018 Jan Van Winkel <jan.van_winkel@dxplore.eu>
# SPDX-License-Identifier: Apache-2.0

config LCD5110
	bool "LCD5110 display driver"
	select MIPI_DBI
	help
	  Enable lcd5110 display driver compliant with display driver API.

config LCD5110_LOG_LEVEL
    int "LCD5110 log level"
    default 3
```

## boards/promicro/supermini_nrf52840/board.yml
```yaml
board:
  name: supermini_nrf52840
  full_name: ProMicro supermini nRF52840
  vendor: promicro
  socs:
  # Physical nRF52840 SoC on PCA10056
  - name: nrf52840
```

## drivers/sensor/Kconfig
```kconfig
# Copyright (c) 2021 Nordic Semiconductor ASA
# SPDX-License-Identifier: Apache-2.0

if SENSOR
rsource "CCS811_sensor/Kconfig"
endif # SENSOR
```
